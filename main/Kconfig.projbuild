## main/Kconfig.projbuild
```kconfig
menu "I2C Configuration"
    config I2C_GPIO_SDA
        int "I2C SDA GPIO Pin"
        default 0
        help
           GPIO Pin to configure as I2C SDA

    config I2C_GPIO_SCL
        int "I2C SCL GPIO Pin"
        default 2
        help
           GPIO Pin to configure as I2C SCL

    config I2C_BME280_ADDRESS
        hex "I2C ADDRESS FOR BME280"
        range 0x76 0x77
        default 0x76
        help
           I2C Address for BME280 Sensor
endmenu

menu "Wifi Configuration"

    config ESP_WIFI_SSID
        string "WiFi SSID"
        default "myssid"
        help
            SSID (network name) for the example to connect to.

    config ESP_WIFI_PASSWORD
        string "WiFi Password"
        default "mypassword"
        help
            WiFi password (WPA or WPA2) for the example to use.

    config ESP_MAXIMUM_RETRY
        int "Maximum retry"
        default 5
        help
            Set the Maximum retry to avoid station reconnecting to the AP unlimited when the AP is really inexistent.
endmenu

menu "MQTT Configuration"

    config BROKER_URL
        string "Broker URL"
        default "mqtt://mqtt.eclipse.org"
        help
            URL of the broker to connect to

    config MQTT_TOPIC
        string "MQTT Topic"
	default "/some/topic"
	help
            Topic for env sensor data

endmenu

menu "DAQ Configuration"

    config SAMPLING_DELAY
	int "Sampling delay"
        default 5000
        help
            Time in milliseconds betwean each measurement

endmenu 
```
